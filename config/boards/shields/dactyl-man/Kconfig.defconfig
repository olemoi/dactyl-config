## config/boards/shields/dactyl-man/Kconfig.defconfig
```kconfig
if SHIELD_DACTYL_MAN_LEFT

config ZMK_KEYBOARD_NAME
    default "Dactyl man"

config ZMK_SPLIT_ROLE_CENTRAL
    default y

endif

if SHIELD_DACTYL_MAN_RIGHT

    config ZMK_KEYBOARD_NAME
        default "Dactyl man right"

endif

if SHIELD_DACTYL_MAN_LEFT || SHIELD_DACTYL_MAN_RIGHT

config ZMK_SPLIT
    default y

endif
```

## config/boards/shields/dactyl-man/Kconfig.shield
```kconfig
config SHIELD_DACTYL_MAN_LEFT
    def_bool $(shields_list_contains,dactyl_man_left)

config SHIELD_DACTYL_MAN_RIGHT
    def_bool $(shields_list_contains,dactyl_man_right)
```
